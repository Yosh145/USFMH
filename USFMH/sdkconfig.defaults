## USFMH/sdkconfig.defaults
```kconfig
# Flash size (8MB — common for ESP32-S3 dev boards)
CONFIG_ESPTOOLPY_FLASHSIZE_8MB=y

# Custom partition table
CONFIG_PARTITION_TABLE_CUSTOM=y
CONFIG_PARTITION_TABLE_CUSTOM_FILENAME="partitions.csv"

# PSRAM (ESP32-S3 octal PSRAM)
CONFIG_SPIRAM=y
CONFIG_SPIRAM_MODE_OCT=y
CONFIG_SPIRAM_SPEED_80M=y

# Increase main task stack for audio processing + SD card I/O
CONFIG_ESP_MAIN_TASK_STACK_SIZE=16384

# FAT filesystem — use 512-byte sectors (standard for SD cards)
CONFIG_FATFS_SECTOR_512=y

# Console over USB Serial/JTAG — stdin/stdout over /dev/ttyACM0
CONFIG_ESP_CONSOLE_USB_SERIAL_JTAG=y

# esp-dsp FFT size: audio_processor uses a 16384-point FFT for its overlap-save
# filterbank. See audio_processor.c for the algorithm.
CONFIG_DSP_MAX_FFT_SIZE_16384=y
CONFIG_DSP_MAX_FFT_SIZE=16384
```
